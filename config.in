## config.in
```kconfig
if PACKAGE_kmod-rtl837x_gsw

menu "SerDes PN Swap Config"
config RTL837x_SDS_0_PN_SWAP_RX_64B66B
	bool "SerDes 0 RX PN Swap for 64B/66B"
	default n

config RTL837x_SDS_1_PN_SWAP_RX_64B66B
	bool "SerDes 1 RX PN Swap for 64B/66B"
	default n

config RTL837x_SDS_0_PN_SWAP_RX_8B10B
	bool "SerDes 0 RX PN Swap for 8B/10B"
	default n

config RTL837x_SDS_1_PN_SWAP_RX_8B10B
	bool "SerDes 1 RX PN Swap for 8B/10B"
	default n
endmenu

config RTL837x_PHY_TX_POLARITY_SWAP
	bool "Swap phy TX polarity"
	default n

config RTL837x_PHY_MDI_SWAP_RX_TX
	bool "Swap phy MDI interfase RX TX"
	default n

endif #PACKAGE_kmod-rtl837x_gsw#
```
